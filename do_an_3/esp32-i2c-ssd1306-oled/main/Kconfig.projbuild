## do_an_3/esp32-i2c-ssd1306-oled/main/Kconfig.projbuild
```kconfig
menu "WIFI CONNECT"

config WIFI_SSID
    string "Tenda_DFB070"
    default "Tenda_DFB070"

config WIFI_PASSWORD
    string "0398765270"
    default "0398765270"  

endmenu
```
