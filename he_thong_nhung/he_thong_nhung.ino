 
//Prateek
//www.prateeks.in

#include <Adafruit_Fingerprint.h>   //https://github.com/adafruit/Adafruit-Fingerprint-Sensor-Library
#include <HardwareSerial.h>
#include <Adafruit_GFX.h>           //https://github.com/adafruit/Adafruit-GFX-Library
#include <Adafruit_SSD1306.h>       //https://github.com/adafruit/Adafruit_SSD1306
#include <SPI.h>
#include <Wire.h>
#include <Servo.h>
Servo myservo;

#include <MFRC522.h>
//Transmit to thingspeak
#include <WiFi.h>
#include "secrets.h"
#include "ThingSpeak.h" // always include thingspeak header file after other header files and custom macros

//Control relay using websever
#include <WebServer.h>
WebServer server(80);
#define DOOR_PIN GPIO_NUM_4
#define DOOR_ON HIGH
#define DOOR_OFF LOW
bool DOORstatus = DOOR_OFF;
const char *ssidAP = "DEMOESP32AP";
const char *passwordAP = "123456789";


#define SCREEN_WIDTH 128 // OLED display width, in pixels
#define SCREEN_HEIGHT 64 // OLED display height, in pixels


#define SS_PIN 5
#define RST_PIN 2


const int ipaddress[4] = {103, 97, 67, 25};
byte nuidPICC[4] = {0, 0, 0, 0};

static int countEmegency = 0;

MFRC522 mfrc522(SS_PIN, RST_PIN);   // Create MFRC522 instance.

//wifi and mqtt

char ssid[] = "Nguyen Duy Quang";   // your network SSID (name) 
char pass[] = "0972385586";   // your network password
int keyIndex = 0;            // your network key Index number (needed only for WEP)
WiFiClient  client;

unsigned long myChannelNumber = 1632141;
const char * myWriteAPIKey = "3FOHB2D70PMUB3XY";

// Initialize our values
int number1 = 0;

String myStatus = "";



// Declaration for an SSD1306 display connected to I2C (SDA, SCL pins)
#define OLED_RESET     -1 // Reset pin # (or -1 if sharing Arduino reset pin)
Adafruit_SSD1306 display(SCREEN_WIDTH, SCREEN_HEIGHT, &Wire, OLED_RESET);

// Icon of Fingerprint
#define LOGO_HEIGHT   64
#define LOGO_WIDTH    128
static const unsigned char PROGMEM logo_bmp[] =
{
  0x00, 0x00, 0x00, 0x00, 0x00, 0x00, 0x00, 0x00, 0x00, 0x00, 0x00, 0x00, 0x00, 0x00, 0x00, 0x00,
  0x00, 0x00, 0x00, 0x00, 0x00, 0x00, 0x00, 0x00, 0x00, 0x00, 0x00, 0x00, 0x00, 0x00, 0x00, 0x00,
  0x00, 0x00, 0x00, 0x00, 0x00, 0x00, 0x03, 0xff, 0xc0, 0x00, 0x00, 0x00, 0x00, 0x00, 0x00, 0x00,
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  0x00, 0x00, 0x00, 0x00, 0x00, 0x00, 0x00, 0x00, 0x00, 0x00, 0x00, 0x00, 0x00, 0x00, 0x00, 0x00
};

Adafruit_Fingerprint finger = Adafruit_Fingerprint(&Serial2);

int buzzerPin = 23;

void match_finger(void);
void init_all(void);
void readRFID(void);
void emergency(void);
/*========================================================== INITIALIZATION ==========================================================*/

void setup()
{
  init_all();
}

/*========================================================== MAIN ==========================================================*/

void loop()                     
{
  match_finger();
  readRFID();
  readServer();
}


void printHex(byte *buffer, byte bufferSize) {
 for (byte i = 0; i < bufferSize; i++) {
   Serial.print(buffer[i] < 0x10 ? " 0" : " ");
   Serial.print(buffer[i], HEX);
 }
}
/**
   Helper routine to dump a byte array as dec values to Serial.
*/
void printDec(byte *buffer, byte bufferSize) {
 for (byte i = 0; i < bufferSize; i++) {
   Serial.print(buffer[i] < 0x10 ? " 0" : " ");
   Serial.print(buffer[i], DEC);
 }
}

/*========================================================== FUNCTION ==========================================================*/

void init_all(void)
{
 pinMode(buzzerPin, OUTPUT);
 digitalWrite(buzzerPin, LOW);
 
 Serial.begin(115200);
 Serial2.begin(115200);

 myservo.attach(DOOR_PIN);
 
  WiFi.mode(WIFI_STA);   
  ThingSpeak.begin(client);  // Initialize ThingSpeak

  //WiFi.softAP(ssidAP, passwordAP);
  //Serial.println(WiFi.softAPIP());
 //Serial.println(WiFi.softAPIP());
 WiFi.begin(ssid, pass);
 Serial.println("");
 // Wait for connection
 while (WiFi.status() != WL_CONNECTED) {
 delay(500);
 Serial.print(".");
 }
 Serial.println("");
 Serial.print("Connected to ");
 Serial.println(ssid);
 Serial.print("IP address: ");
 Serial.println(WiFi.localIP());
 // server.on("/", []() {
 // server.send(200, "text/plain", "ESP32 Webserver running");
 // });
 server.on("/", handleRoot);
 server.on("/dooropen", []() {
 DOORstatus = DOOR_ON;
 Serial.println("Set DOOR to OPEN");
 server.send(200, "text/html", SendHTML(DOORstatus));
 });
 server.on("/doorlock", []() {
 DOORstatus = DOOR_OFF;
 Serial.println("Set DOOR to OFF");
 server.send(200, "text/html", SendHTML(DOORstatus));
 });
 server.onNotFound(handleNotFound);
 server.begin();
 Serial.println("HTTP server started");  
  
// SSD1306
if(!display.begin(SSD1306_SWITCHCAPVCC, 0x3C)) 
{ 
    Serial.println(F("SSD1306 allocation failed"));
    for(;;); // Don't proceed, loop forever
  }
 
 while (!Serial); 
 delay(100);
 
 display.clearDisplay();
 display.drawBitmap(0, 0, logo_bmp, LOGO_WIDTH, LOGO_HEIGHT, 1);
 display.display();
 Serial.println("Fingerprint Door Lock");
 delay(3000);
 display.clearDisplay();
 
//FINGERPRINT
 // set the data rate for the sensor serial port
 finger.begin(57600);

 if (finger.verifyPassword()) 
 {
   Serial.println("Fingerprint Sensor Connected");
   display.clearDisplay();
   display.setTextSize(2);             // Normal 1:1 pixel scale
   display.setTextColor(SSD1306_WHITE);        // Draw white text
   display.setCursor(25, 0);            // Start at top-left corner
   display.println(("Sensor"));
   display.setCursor(5, 35);
   display.println("Connected");
   display.display();
   delay(3000); 
  // display.clearDisplay();
 }

 else  
 {
   display.clearDisplay();
   display.setTextSize(2);             // Normal 1:1 pixel scale
   display.setTextColor(SSD1306_WHITE);        // Draw white text
   display.setCursor(25, 0);            // Start at top-left corner
   display.println(("Sensor"));
   display.setCursor(5, 35);
   display.println("Not Found");
   display.display();
   
   Serial.println("Unable to find Sensor");
   delay(3000);
   Serial.println("Check Connections");

   while (1) {
     delay(1);
   }
 }
  display.clearDisplay();
  SPI.begin();
  mfrc522.PCD_Init();   // Initiate MFRC522
  delay(5);

}

/*========================================================== RFID ==========================================================*/

void readRFID()
{
  if ( ! mfrc522.PICC_IsNewCardPresent()) 
  {
    return;
  }
  // Select one of the cards
  if ( ! mfrc522.PICC_ReadCardSerial()) 
  {
    return;
  }
  String content= "";
  byte letter;
  for (byte i = 0; i < mfrc522.uid.size; i++) 
  {
     content.concat(String(mfrc522.uid.uidByte[i] < 0x10 ? " 0" : " "));
     content.concat(String(mfrc522.uid.uidByte[i], HEX));
  }

  content.toUpperCase();
  
  if (content.substring(1) == "A3 A9 49 06") //change here the UID of the card/cards that you want to give access
  {

    Serial.println("Authorized access");    display.clearDisplay();
    display.setTextSize(2);             // Normal 1:1 pixel scale
    display.setTextColor(SSD1306_WHITE);        // Draw white text
    display.setCursor(0, 0);            // Start at top-left corner
    display.println(("RFID access"));
    display.clearDisplay();
    open_door();   
  }
 
 else   {
    Serial.println(" Access denied");
   display.clearDisplay();
   display.setTextSize(2);             // Normal 1:1 pixel scale
   display.setTextColor(SSD1306_WHITE);        // Draw white text
   display.setCursor(10, 0);            // Start at top-left corner
   display.println(("RFID not valid"));
   display.clearDisplay();
    if(++countEmegency == 10)
    {
      countEmegency = 0;
      emergency();
    }
     }
}

/*========================================================== FINGERPRINT ==========================================================*/

void match_finger(void)
{
    getFingerprintIDez();
    delay(50);    
}

int getFingerprintIDez() 
{
 uint8_t p = finger.getImage();
 if (p != FINGERPRINT_OK)  
 {

   display.clearDisplay();
   display.drawBitmap(0, 0, logo_bmp, LOGO_WIDTH, LOGO_HEIGHT, 1);
   display.display();
   Serial.println("Waiting For Valid Finger");
   return -1;
 }

 p = finger.image2Tz();
 if (p != FINGERPRINT_OK)  
 {
   display.clearDisplay();
   display.setTextSize(2);             // Normal 1:1 pixel scale
   display.setTextColor(SSD1306_WHITE);        // Draw white text
   display.setCursor(0, 0);            // Start at top-left corner
   display.println(("Prateek Image"));
   display.setCursor(0, 35);
   display.println("Try Again");
   display.display();
   
   Serial.println("Prateek Image Try Again");
   delay(3000);
   display.clearDisplay();
   return -1;
 }

 p = finger.fingerFastSearch();
 if (p != FINGERPRINT_OK)  {
   
   display.clearDisplay();
   display.setTextSize(2);             // Normal 1:1 pixel scale
   display.setTextColor(SSD1306_WHITE);        // Draw white text
   display.setCursor(20, 0);            // Start at top-left corner
   display.println(("Invalid"));
   display.setCursor(25, 20);
   display.println("Finger");
   display.setCursor(10, 40);
   display.println("Try Again");
   display.display();
   Serial.println("Not Valid Finger");
   delay(3000);
   display.clearDisplay();
    if(++countEmegency == 10)
    {
      countEmegency = 0;
      emergency();
    }   
   return -1;
 }

 // found a match!
   Serial.println("Fingerprint access"); 
   open_door();
   
   return finger.fingerID;
}



/*========================================================== WEB SERVER ==========================================================*/
void handleNotFound() {
 String message = "File Not Found\n\n";
 message += "URI: ";
 message += server.uri();
 message += "\nMethod: ";
 message += (server.method() == HTTP_GET) ? "GET" : "POST";
 message += "\nArguments: ";
 message += server.args();
 message += "\n";
 for (uint8_t i = 0; i < server.args(); i++) {
 message += " " + server.argName(i) + ": " + server.arg(i) + "\n";
 }
 server.send(404, "text/plain", message);
}
String SendHTML(uint8_t doorstat) {
 String ptr = "<!DOCTYPE html> <html>\n";
 ptr += "<head><meta name=\"viewport\" content=\"width=device-width, initial-scale=1.0, user-scalable=no\">\n";
 ptr += "<title>DOOR Control</title>\n";
 ptr += "<style>html { font-family: Helvetica; display: inline-block; margin: 0px auto; text-align: center;}\n";
 ptr += "body{margin-top: 50px;} h1 {color: #444444;margin: 50px auto 30px;} h3 {color: #444444;margin-bottom: 50px;}\n";
 ptr += ".button {display: block;width: 80px;background-color: #3498db;border: none;color: white;padding: 13px 30px;text-decoration: none;font-size: 25px;margin: 0px auto 35px;cursor: pointer;border-radius: 4px;}\n";
 ptr += ".button-on {background-color: #3498db;}\n";
 ptr += ".button-on:active {background-color: #2980b9;}\n";
 ptr += ".button-off {background-color: #34495e;}\n";
 ptr += ".button-off:active {background-color: #2c3e50;}\n";
 ptr += "p {font-size: 14px;color: #888;margin-bottom: 10px;}\n";
 ptr += "</style>\n";
 ptr += "</head>\n";
 ptr += "<body>\n";
 ptr += "<h1>ESP32 Web Server</h1>\n";
 if (doorstat)
 {
 ptr += "<p>DOOR1 Status: ON</p><a class=\"button button-off\" href=\"/doorlock\">OFF</a>\n";
 }
 else
 {
 ptr += "<p>DOOR Status: OFF</p><a class=\"button button-on\" href=\"/dooropen\">ON</a>\n";
 }
 ptr += "</body>\n";
 ptr += "</html>\n";
 return ptr;
}
void handleRoot() {
 server.send(200, "text/html", SendHTML(DOORstatus));
}
void readServer()
{
  server.handleClient();
  if(DOORstatus)
  {
    DOORstatus = DOOR_OFF;
    open_door();
  }
}
/*========================================================== DOOR ACTION ==========================================================*/
//Function open door
void open_door()
{
   display.clearDisplay();
   display.setTextSize(2);             // Normal 1:1 pixel scale
   display.setTextColor(SSD1306_WHITE);        // Draw white text
   display.setCursor(40, 0);            // Start at top-left corner
   display.println(("Door"));
   display.setCursor(15, 20);            // Start at top-left corner
   display.println(("Unlocked"));
   display.setCursor(20, 40);
   display.println("Welcome");
   display.display();
   
   myservo.write(90);
   //digitalWrite(buzzerPin, HIGH);
   delay(6000);
   
   display.clearDisplay();
   display.setTextSize(2);             // Normal 1:1 pixel scale
   display.setTextColor(SSD1306_WHITE);        // Draw white text
   display.setCursor(20, 10);            // Start at top-left corner
   display.println(("Closing"));
   display.setCursor(20, 30);            // Start at top-left corner
   display.println(("the Door"));
   display.display();
   
   myservo.write(0);
   //digitalWrite(buzzerPin, LOW);
   delay(3000);
   
   display.clearDisplay();
   
   Serial.println("Door Unlocked Welcome");

//CONNECT TO THE THINGSPEAK  

  if(WiFi.status() != WL_CONNECTED){
    Serial.print("Attempting to connect to SSID: ");
    Serial.println(SECRET_SSID);
    while(WiFi.status() != WL_CONNECTED){
      WiFi.begin(ssid, pass);  // Connect to WPA/WPA2 network. Change this line if using open or WEP network
      Serial.print(".");
      delay(5000);     
    } 
    Serial.println("\nConnected.");
  }

  // set the fields with the values
  ThingSpeak.setField(1, number1);

  // set the status
  ThingSpeak.setStatus(myStatus);
  
  // write to the ThingSpeak channel
  int x = ThingSpeak.writeFields(myChannelNumber, myWriteAPIKey);
  if(x == 200){
    Serial.println("Channel update successful.");
  }
  else{
    Serial.println("Problem updating channel. HTTP error code " + String(x));
  }
  
  // change the values
  number1+=5;
  if(number1 > 100){
    number1 = 0;
  }
  else 
  {
    number1 = 0;
  }
}

void emergency()
{
  int temp = 0;
  while(1)
  {
    if(++temp == 10)
    {
      temp = 0;
      break;
    }
   digitalWrite(buzzerPin, HIGH);
   delay(1000);
   digitalWrite(buzzerPin, LOW);
   delay(1000);
  }
}
